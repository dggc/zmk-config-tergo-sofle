## config/west.yml
```yaml
manifest:
  defaults:
    remote: urob
    revision: v0.2.1 # Pin everything to v0.2.1
  remotes:
    - name: zmkfirmware
      url-base: https://github.com/zmkfirmware
    - name: urob
      url-base: https://github.com/urob
    - name: englmaxi
      url-base: https://github.com/englmaxi
    # Additional modules containing boards/shields/custom code can be listed here as well
    # See https://docs.zephyrproject.org/3.2.0/develop/west/manifest.html#projects
  projects:
    - name: zmk
      remote: zmkfirmware
      import: app/west.yml

    - name: zmk-dongle-display
      remote: englmaxi
      revision: 5dbeb0d03d26648d5ef454b46422e957ddfc2c32

    # ZMK modules
    - name: zmk-helpers
      path: modules/zmk/helpers
    - name: zmk-auto-layer
      path: modules/zmk/auto-layer
    # - name: zmk-adaptive-key
    #   path: modules/zmk/adaptive-key
    # - name: zmk-leader-key
    #   path: modules/zmk/leader-key
    # - name: zmk-tri-state
    #   path: modules/zmk/tri-state

    # Temporarily overload Zephyr until
    # https://github.com/zmkfirmware/zephyr/pull/40 is merged.
    - name: zephyr
      revision: v3.5.0+zmk-fixes
      clone-depth: 1
      import:
        # Only enable most commonly used boards. For less common hardware one
        # may need to enable additional modules.
        name-allowlist:
          - cmsis
          - hal_nordic
          - hal_rpi_pico
          - hal_stm32
          - lvgl
          - tinycrypt
  self:
    path: config
```
